## package/feeds/ltq_feeds_netcomp_cpe/ifx_IFXAPIs/config/Config.in
```kconfig
config FEATURE_IFX_TURBONAT
	bool 'TurboNAT'
	help
	  Support for TurboNAT

config FEATURE_IPv6
	bool 'Enable IPv6 Support'
	help
	  Enable IPv6 Support

config FEATURE_RIP
    bool 'RIP Support'
    depends on FEATURE_ZEBRA
    help
      Dynamic Routing support by RIP

config FEATURE_IFX_CHINA_MKT_1
	bool 'Enable Settings for China Market'
	help
	  Enable settings for China Market

config FEATURE_IFX_LOW_FOOTPRINT
	bool 'Enable Low FootPrint'
	help
	  Enable Low FootPrint

config FEATURE_IFX_USB_DEVICE
	bool 'Enable USB Device Mode Support'
	help
	  Enable USB Device Mode Support

config FEATURE_IFX_USB_DEVICE_MODULE
	bool 'USB Module Support'
	depends on FEATURE_IFX_USB_DEVICE
	help
	  USB Module Support

config FEATURE_IFX_USB_DEVICE_BUILTIN
	bool 'USB Builtin Support'
	depends on FEATURE_IFX_USB_DEVICE
	help
	  USB Builtin Support

config FEATURE_IFX_USB_HOST
	bool 'USB Host Mode Support'
	help
	  Enable USB Host Mode Support

config FEATURE_IFX_ADM6996_UTILITY
	bool 'ADM6996 Utility'
	help
	  Support for ADM6996 utility

config FEATURE_IFX_IGMPPROXY
	bool 'IGMP Proxy & Snooping support'
	help
	  Support for IGMP Proxy & Snooping

config FEATURE_IFX_WIRELESS
	bool 'Wireless support'
	depends FEATURE_IFX_WIRELESS_WAVE300 || FEATURE_IFX_WIRELESS_ATHEROS
  default n
	help
	  Wireless support

config FEATURE_IFX_WIRELESS_RALINK
	bool 'Ralink Wireless'
	depends FEATURE_IFX_WIRELESS && PACKAGE_ralink
        depends !PACKAGE_ltq-wlan-wave && !PACKAGE_atheros && !PACKAGE_lq-wave100
	default y
	help
	  Support for Ralink

config FEATURE_IFX_WIRELESS_WAVE100
	bool 'WAVE100 Wireless'
	depends FEATURE_IFX_WIRELESS && PACKAGE_lq-wave100 
	depends !PACKAGE_ltq-wlan-wave && !PACKAGE_atheros && !PACKAGE_ralink
	default y
	help
	  Support for WAVE100

config FEATURE_IFX_WIRELESS_WAVE300
        bool 'Wave300 Wireless'
        depends FEATURE_IFX_WIRELESS && PACKAGE_ltq-wlan-wave
	default y
        help
          Support for Wave300 

config FEATURE_LTQ_WIRELESS_VB	
	bool 'Video Bridge Features'
	depends TARGET_ltqcpe_platform_vbg400 || TARGET_ltqcpe_platform_ar9_VB
	default y
	help
	  Support for VB platforms

config FEATURE_LTQ_WIRELESS_VBG400_CHIPIT	
	bool 'VBG400 Chip-It Features'
	depends TARGET_ltqcpe_platform_vbg400
	help
	  Support for VBG400 chipit platforms

config FEATURE_IFX_WIRELESS_ATHEROS
        bool 'Atheros Wireless'
        depends FEATURE_IFX_WIRELESS && PACKAGE_atheros
        default y
        help
          Support for Atheros


config FEATURE_IFX_CONCURRENT_DUAL_WIRELESS
                bool 'Concurrent Dual-Band Wireless Support'
		depends FEATURE_IFX_WIRELESS_WAVE300 || FEATURE_IFX_WIRELESS_ATHEROS
                default n
                help
                  Support for Concurrent Dual-Band Wireless


config FEATURE_IFX_WLAN_WMM
	bool 'Wi-Fi WMM support'
	depends FEATURE_IFX_WIRELESS
	default y
	help
	  Support for Wi-Fi WMM (Quality of Service)

config FEATURE_IFX_WLAN_WPS
	bool 'WiFi WPS support'
	depends FEATURE_IFX_WIRELESS
	default y
	help
	  Support for WPS feature (WiFi Protected Setup)

config FEATURE_IFX_DSL_MANAGEMENT
	bool 'DSL Management'
	help
	  DSL Management

config FEATURE_IFX_ILMI
	bool 'ILMI support'
	help
	  ILMI support

config FEATURE_IFX_VOIP
	bool 'VOIP support'
	depends PACKAGE_ifx-voip
	default y
	help
	  VOIP support

config FEATURE_IFX_TAPIv3
	bool 'TAPI V3'
	help
	  TAPI V3 support

config FEATURE_FIREWALL
	bool 'Firewall support'
	help
	  Firewall support

config FEATURE_NAPT
	bool 'NAPT support'
	help
	  IP address and port translation support

config FEATURE_DHCP_SERVER
	bool 'DHCP Server support'
	help
	  Support for DHCP Server configuration APIs

config FEATURE_DHCP_RELAY_
	bool 'DHCP Relay support'
	help
	  Support for DHCP Relay configuration APIs

config FEATURE_ALGS
	bool 'Support for ALGs'
	help
		Support for ALGs

config FEATURE_SELECTIVE_BACKUP_RESTORE
    bool 'Support for Partial Backup and Restore'
    help
       Support for Partial Backup and Restore

config FEATURE_IFX_MAPI
		bool 'MAPI framework support'
		depends on PACKAGE_ifx-IFXAPIs
		help
			MAPI framework support for user configuration read/write

config FEATURE_LTQ_VLAN_SWITCH_PORT_ISOLATION
		bool 'VLAN Based Switch ports isolation support'
		select PACKAGE_kmod-ltq_vlan_switchport_isolation
		default y
                help
			Separate the lan ports based on vlan 

config FEATURE_LTQ_SWITCH_PORT_ISOLATION
		bool 'Switch ports isolation support'
		depends TARGET_ltqcpe_platform_vr9 || TARGET_ltqcpe_platform_ar10
		select PACKAGE_kmod-ltq_switchport_isolation
		default n
                help
			Separate the lan ports based on PPA headers 

config FEATURE_LTQ_PORT_WAN_BINDING
		bool 'Port WAN binding support'
		select PACKAGE_kmod-ltq_portbinding
		select PACKAGE_ip
		select PACKAGE_ebtables
		select PACKAGE_kmod-ebtables
		select PACKAGE_kmod-ebtables-ipv4
		default n
		help
			Create the binding between LAN ports or interfaces and existing WAN interface


config FEATURE_IFX_MAPI_DEBUG
                bool 'DEBUG Support'
		default n
                help
                        Debug support for APIs

config FEATURE_MEDIA_SERVER
	bool 'Media server support'
	depends PACKAGE_minidlna
	default y if PACKAGE_minidlna
	help
	  MAPI framework support for Media server

config FEATURE_DUAL_WAN_SUPPORT
	bool 'Dual WAN Support'
	depends on PACKAGE_ifx-IFXAPIs
	depends on FEATURE_CELL_WAN_SUPPORT || FEATURE_WWAN_LTE_SUPPORT
	default n
	help
	   Dual WAN Support 

config FEATURE_URL_FILTERING
	bool 'URL filtering'
	depends on PACKAGE_iptables
	default n
	help
		URL based filtering

config RC_CONF_RW_OPTIMISATION
	bool 'RC.CONF read/write Optimisation'
	default y
	help
		Seek point optimisation for read/write rc.conf file 
```

## package/feeds/ltq_feeds_netcomp_cpe/ifx_httpd/config/Config.in
```kconfig
config FEATURE_IFX_MULTIPLE_VCCS
	bool 'Multiple VCCs support'
	help
	  Support for multiple vccs configuration support

config FEATURE_IFX_IPQOS
	bool 'IP QoS'
	help
	  Support for IP QoS

config FEATURE_IFX_USB_HOST
	bool 'USB Host Mode support'
	help
	  Support for USB Host Mode Configuration

config FEATURE_DDNS
        bool 'Dynamic DNS support'
        help 
          Support for Dynamic DNS Configuration

config FEATURE_IFX_HTTP_DEBUG
                bool 'DEBUG Support'
                default n
		help
                        Debug support for APIs

config FEATURE_SYSTEM_PERFORMANCE_CHARTS
	bool 'System Performance Charts'
	select PACKAGE_pecostat
	help
	  Support for System Performance Charts

config FEATURE_HTTPS
	bool 'HTTPs support'
	default n
	select PACKAGE_mini-httpd-openssl
	help
		Support for HTTPs

config FEATURE_MAC_BASED_WEB_SESSION_HANDLE
        bool 'Mac based web session handle'
        default n
        help
          Support for handling web session based on mac address
          apart from ip address

config FEATURE_VDSL_VECTORING 
	bool 'VDSL Vectoring Support'
	default n
    	depends on PACKAGE_ifx-dsl-cpe-control-vrx && PACKAGE_kmod-ltqcpe_vdsl_vectoring_support
	help
		VDSL Vectoring Support
```

## package/feeds/ltq_feeds_netcomp_cpe/lq_igmpd/config/Config.in
```kconfig
choice
	prompt "LTQ Multicast feature set"
		default FEATURE_LTQ_IGMP_PREMIUM_FEATURES
		help
		 Select the LTQ Multicast feature set.

		config FEATURE_LTQ_IGMP_STANDARD_FEATURES
			bool "Standard"
			help
			  This will compile and install multicast daemon with standard features.

		config FEATURE_LTQ_IGMP_PREMIUM_FEATURES
			bool "Premium"
			help
			  This will compile and install multicast daemon with premium features
			  such as 'per port based fast leave', 'explicit host tracking' and 'hardware snooping'

endchoice

config FEATURE_LTQ_MCAST_FILTER_PORT
	bool 'Supports only snooping for the filtered ports'
	depends on PACKAGE_lq-igmpd
	default n
	help
	  This is only configures the snooping for the filtered ports,


config FEATURE_LTQ_IGMP_AUTOWAN_UPDATE
	bool 'Automatically update wan settings on wan type change'
	depends on PACKAGE_lq-igmpd
	default y
	help
	  If multicast is configuraed with a particular wan type and if the wan type is changed,
	  it is automatically refleced in igmp web page and multicast service automatically 
	  runs on new wan type ( does not need manual configuration from user).
```

## package/feeds/ltq_feeds_uboot/open_uboot/config_ori/Kconfig
```kconfig
config LANTIQ_UBOOT_danube
	bool
	default y
	depends on ( TARGET_ltqcpe_danube || TARGET_ltqcpe_platform_danube || TARGET_ifxcpe_platform_danube )

config LANTIQ_UBOOT_amazon_se
    bool
	default y
	depends on ( TARGET_ltqcpe_amazon_se || TARGET_ltqcpe_platform_amazon_se || TARGET_ifxcpe_platform_amazon_se )
			
config LANTIQ_UBOOT_ar9
    bool
    default y
    depends on ( TARGET_ltqcpe_ar9 || TARGET_ltqcpe_platform_ar9 || TARGET_ifxcpe_platform_ar9 )

config LANTIQ_UBOOT_vr9
    bool
	default y
	depends on ( TARGET_ltqcpe_vr9 || TARGET_ltqcpe_platform_vr9 || TARGET_ifxcpe_platform_vr9 )
			
config LANTIQ_UBOOT_ar10
    bool
	default y
	depends on ( TARGET_ltqcpe_ar10 || TARGET_ltqcpe_platform_ar10 || TARGET_ifxcpe_platform_ar10 || TARGET_lantiq_xrx300)
			
config LANTIQ_UBOOT_grx390
    bool
    default y
    select LANTIQ_UBOOT_ar10
	depends on ( TARGET_ltqcpe_platform_ar10_GRX390 || TARGET_lantiq_xrx330 )

config LANTIQ_UBOOT_hn1
    bool
    default y
    depends on ( TARGET_ltqcpe_hn1 || TARGET_ltqcpe_platform_hn1 || TARGET_ifxcpe_platform_hn1 )
			

source package/feeds/ltq_feeds_uboot/open_uboot/config/scripts_platform/Kconfig
```

## package/feeds/ltq_feeds_wave_mbssid/lq-wave100/config/Config.in
```kconfig
config FEATURE_LQ_WAVE100_EXT_PA
	bool 'Select external PA configuration'
        default n
	help
	  Select external PA configuration
```

## package/feeds/ltq_gpon_onu/gpon-dti-agent/config/Config.in
```kconfig
config GPON_DTI_DEVICE_OCAL
	bool
	prompt "Enable GPON OCAL device support"
	default n
	select PACKAGE_gpon-ocal
```

## package/feeds/ltq_gpon_onu/gpon-flow-api/config/Config.in
```kconfig
config GPON_FLOW_API_TEST_APP
	bool
	prompt "Enable Flow API test application"
	default n

config GPON_FLOW_API_TEST_APP_READLINE
	depends GPON_FLOW_API_TEST_APP
	select PACKAGE_libreadline
	select PACKAGE_libncurses
	bool
	prompt "Enable history and line editing support for the Flow API test application"
	default n

config GPON_FLOW_API_DEBUG_PRINTS
	bool
	prompt "Enable Flow API debug printouts"
	default y

config GPON_FLOW_API_REMOTE
	bool "Enable remote ONU support"
	default n
```

## package/feeds/ltq_gpon_onu/gpon-ocal/config/Config.in
```kconfig
config GPON_OCAL_CLI_DAEMON
	bool
	prompt "Enable GPON OCAL CLI-daemon support"
	default y
	select PACKAGE_lib-cli
```

## package/feeds/ltq_gpon_onu/gpon-omci-api/config/Config.in
```kconfig
config GPON_OMCI_API_DEBUG_PRINTS
	bool
	prompt "Enable verbose debug output"
	default n

config GPON_OMCI_ONU_FALCON_SW_IMAGE_SUPPORT
	bool
	prompt "Enable SW image support using the u-boot on FALCON platform"
	default n
	select PACKAGE_uboot-envtools

config GPON_OMCI_API_DMALLOC
	bool "Enable heap debugging with dmalloc library"
	default y if GPON_OMCI_ONU_DMALLOC

config GPON_OMCI_API_VOIP
	bool "Enable VoIP support"
	default n
	select PACKAGE_pjsip-ltq-tapi

config GPON_OMCI_API_MCC
	bool "Enable Multicast Control support"
	default y
	depends on !GPON_OMCI_API_REMOTE_ONLY

config GPON_OMCI_API_REMOTE
	bool "Enable remote ONU support"
	default y if GPON_OMCI_ONU_REMOTE

config GPON_OMCI_API_REMOTE_ONLY
	bool "Enable remote-only ONU support"
	default y if GPON_OMCI_ONU_REMOTE_ONLY
	select GPON_OMCI_API_REMOTE
```

## package/feeds/ltq_gpon_onu/gpon-omci-onu-ocs/config/Config.in
```kconfig
config GPON_OMCI_ONU_CLI
	bool
	prompt "Enable CLI support"
	default y

config GPON_OMCI_ONU_CLI_PIPE
	bool
	prompt "Enable CLI support through pipe"
	default y

config GPON_OMCI_ONU_SELF_DESCRIPTION
	bool
	prompt "Enable OMCI, Managed Entity and Attribute MEs"
	default y

config GPON_OMCI_ONU_FALCON_SW_IMAGE_SUPPORT
	bool
	prompt "Enable SW image support using the u-boot on FALCON platform"
	default n
	
config GPON_OMCI_ONU_UDP_SIMULATION
	bool
	prompt "Enable OMCI simulation over UDP connection"
	default n
	
config GPON_OMCI_ONU_OCS_LITTLE_ENDIAN
	bool
	prompt "Enable OCS-OMCI Stack compilation for target with little endiand byte order"
	default y
	
config GPON_OMCI_ONU_OCS_TRACE
	bool
	prompt "Enable OCS-OMCI Stack debug trace"
	default y
	
config GPON_OMCI_ONU_OCS_UNKNOWNCLASS_IGNORE
	bool
	prompt "Enable OCS-OMCI Stack unknown ME class ignore"
	default y
	
config GPON_OMCI_ONU_OCS_INTEGRATED_ONT
	bool
	prompt "Enable OCS-OMCI Stack compilation for integrated ONT"
	default n
```

## package/feeds/ltq_gpon_onu/gpon-omci-onu/config/Config.in
```kconfig
config GPON_OMCI_ONU_CLI
	bool
	prompt "Enable CLI support"
	default y
	select PACKAGE_lib-cli

config GPON_OMCI_ONU_CLI_PIPE
	bool
	prompt "Enable CLI support through pipe"
	default y
	depends on GPON_OMCI_ONU_CLI

config GPON_OMCI_ONU_DEBUG_PRINTS
	bool
	prompt "Enable verbose debug output"
	default y

config GPON_OMCI_ONU_FORMATTED_OMCI_DUMP
	bool
	prompt "Enable formatted dump of OMCI messages"
	default y

config GPON_OMCI_ONU_SELF_DESCRIPTION
	bool
	prompt "Enable OMCI, Managed Entity and Attribute MEs"
	default y

config GPON_OMCI_ONU_PM
	bool
	prompt "Enable PM Managed Entities"
	default y

config GPON_OMCI_ONU_UDP_SIMULATION
	bool
	prompt "Enable OMCI simulation over UDP connection"
	default n

config GPON_OMCI_ONU_UDP_SIMULATION_OLT
	string "Define remote OLT arguments"
	default "1,1,192.168.0.8:10000"
	depends on GPON_OMCI_ONU_UDP_SIMULATION

config GPON_OMCI_ONU_DEFAULT_MIB
	string "Select default MIB (please refer to ONU_OMCI_Olt_t)"
	default "0"

config GPON_OMCI_ONU_VOIP
	bool "Enable VoIP support"
	default n
	select GPON_OMCI_API_VOIP

config GPON_OMCI_ONU_UCI
	bool
	prompt "Enable OMCI Unified Configuration Interface"
	default y
	select PACKAGE_ipwatchd

config GPON_OMCI_ONU_UCI_MAP_LIB
	bool
	prompt "Specify whether UCI map lib is availble" if GPON_OMCI_ONU_UCI
	default y
	help
		Specify whehter the libucimap must be linked or not.
	
config GPON_OMCI_ONU_DMALLOC
	bool
	prompt "Enable heap debugging with dmalloc library"
	default n
	select PACKAGE_libdmalloc

config GPON_OMCI_ONU_REMOTE
	bool "Enable remote ONU support"
	default y

config GPON_OMCI_ONU_REMOTE_ONLY
	bool "Enable remote-only ONU support"
	default n
	select GPON_OMCI_ONU_REMOTE
```
