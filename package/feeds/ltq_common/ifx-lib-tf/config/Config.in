## package/feeds/ltq_gpon_onu/gpon-onu-drv/config/Config.in
```kconfig
config GPON_ONU_CLI_DUMP
	bool
	prompt "Enable the CLI dump feature"
	default y

config GPON_ONU_CLI
	bool
	prompt "Enable the CLI support"
	default y

choice
	prompt "Device Selection"
	default GPON_ONU_DEVICE_PSB98030
	help
	  Select the device variant

	config GPON_ONU_DEVICE_PSB98010
		bool "PSB98010"

	config GPON_ONU_DEVICE_PSB98020
		bool "PSB98020"

	config GPON_ONU_DEVICE_PSB98030
		bool "PSB98030"
endchoice

config GPON_ONU_TOD_ASC1
	bool
	prompt "Print TOD output on ASC1"
	default n
	depends on !GPON_ONU_REMOTE_ONLY

config GPON_ONU_EXPORT_SYMBOLS
	bool
	prompt "Export debug symbols"
	default n

config GPON_ONU_SCE_TABLES_WRAPPERS
	bool
	prompt "Enable XML & JSON SCE tables wrappers"
	default y

config GPON_ONU_MAX_ETH_UNI
	int "Maximum number of supported LAN ports"
	default 4

config GPON_DRV_ONU_EVENT_LOGGER
	bool "Event-logger support"
	default n
	help
		Option to build event-logger support into the onu driver

config GPON_ONU_DEBUG
	bool "Enable driver debug support"
	default y

config GPON_ONU_COP_DEBUG
	bool "Enable COP debug support"
	default y

config GPON_ONU_SCE_DEBUG
	bool "Enable SCE debug support"
	default y

config GPON_ONU_PROCFS
	bool "Enable procfs"
	default y
	depends on !GPON_ONU_REMOTE_ONLY

choice
	prompt "Remote Support Selection"
	default GPON_ONU_REMOTE_ONLY if GPON_OMCI_API_REMOTE_ONLY || GPON_OMCI_ONU_REMOTE_ONLY

	help
	  Select the remote support

	config GPON_ONU_NO_REMOTE
		bool "Disable remote ONU support"

	config GPON_ONU_REMOTE
		bool "Enable remote ONU support"
	
	config GPON_ONU_REMOTE_ONLY
		bool "Enable remote-only ONU support"
endchoice
		
```

## package/feeds/ltq_gpon_onu/gpon-onu-firmware/config/Config.in
```kconfig
config GPON_ONU_FIRMWARE_UBOOT
	bool
	prompt "Enable u-boot image"
	default y

config GPON_ONU_FIRMWARE_IP_ADDR
	string "firmware IP address"
	default "192.168.1.2"

config GPON_ONU_FIRMWARE_IP_NETMASK
	string "firmware IP netmask"
	default "255.255.255.0"
```

## package/feeds/ltq_gpon_onu/gpon-optic-drv/config/Config.in
```kconfig
config GPON_OPTIC_CLI
	bool
	prompt "Enable the CLI support"
	default y

config GPON_OPTIC_PROCFS
	bool
	prompt "Enable procfs"
	default y

config GPON_DRV_OPTIC_EVENT_LOGGER
	bool "Event-logger support"
	default n
	help
		Option to build event-logger support into the optic driver

config GPON_OPTIC_DEBUG
	bool "Enable driver debug support"
	default y

choice
	prompt "Remote Support Selection"
	default GPON_OPTIC_REMOTE_ONLY if GPON_OMCI_API_REMOTE_ONLY || GPON_OMCI_ONU_REMOTE_ONLY

	help
	  Select the remote support

	config GPON_OPTIC_NO_REMOTE
		bool "Disable remote ONU support"

	config GPON_OPTIC_REMOTE
		bool "Enable remote ONU support"
	
	config GPON_OPTIC_REMOTE_ONLY
		bool "Enable remote-only ONU support"
endchoice
	
```

## package/feeds/ltq_gpon_onu/gpon-rpc/config/Config.in
```kconfig
config GPON_RPC_SOCKET
	bool
	prompt "Enable remote ONU access"
	default y
config GPON_RPC_USE_DEFAULT_ONU_FIRMWARE_REMOTE_IP
	bool
	prompt "Use Default remote IP address specified by the ONU firmware"
	default n
```

## package/feeds/ltq_gpon_onu/gpon-sipdemo/Config.in
```kconfig
menu "Configuration"
depends on PACKAGE_gpon-sipdemo
choice
	prompt "board selection"
	default GPON_SIPDEMO_BOARD_EASY507XX  if TARGET_ifxmips_danube
	default GPON_SIPDEMO_BOARD_EASY508XX  if TARGET_ifxmips_ar9
	default GPON_SIPDEMO_BOARD_EASY507XX
	help
		Select the target platform.

	config GPON_SIPDEMO_BOARD_EASY507XX
		bool "Easy507xx reference board"

	config GPON_SIPDEMO_BOARD_EASY508XX
		bool "Easy508xx reference board"
endchoice

endmenu
```

## package/feeds/ltq_voice_cpe/ifx-voice-cpe-tapi-duslic_xt-coef/config/Config.in
```kconfig
choice
   depends on PACKAGE_ifx-voice-cpe-tapi-duslic_xt-coef
   prompt "FXS coefficients"
   default IFX_VOICE_CPE_DXT_COEF_ETSI
   help
      Select country specific FXS coefficient file.

   config IFX_VOICE_CPE_DXT_COEF_ETSI
      bool "ETSI_T3R10: Vl:40V, Ic:25mA, Vid:25V, Vri:45Vrms, f:25Hz"
      help
        These coefficents contains a parameter set with line impedance Zr according to ETSI.

        T:   gain in transmit direction (attenuation 3dBr) [dBr]
        R:   gain in receive direction (attenuation 10dBr) [dBr]
        Vl:  on-hook voltage limit [V]
        Ic:  off-hook loop current [mA]
        Vid: low-power-standby voltage [V]
        Vri: ring voltage [v]
        f:   ring frequency [V]

   config IFX_VOICE_CPE_DXT_COEF_US600R
      bool "USA_600R_T3R10: Vl:40V, Ic:25mA, Vid:25V, Vri:45V, f:25Hz"
      help
        These coefficents contains a parameter set with line impedance e.g. for USA.

        T:   gain in transmit direction (attenuation 3dBr) [dBr]
        R:   gain in receive direction (attenuation 10dBr) [dBr]
        Vl:  on-hook voltage limit [V]
        Ic:  off-hook loop current [mA]
        Vid: low-power-standby voltage [V]
        Vri: ring voltage [v]
        f:   ring frequency [V]

   config IFX_VOICE_CPE_DXT_COEF_GERMANY
      bool "GERM_T3R10: Vl:40V, Ic:25mA, Vid:25V, Vri:45Vrms, f:25Hz"
      help
        These coefficents contains a parameter set with line impedance for Germany.

        T:   gain in transmit direction (attenuation 3dBr) [dBr]
        R:   gain in receive direction (attenuation 10dBr) [dBr]
        Vl:  on-hook voltage limit [V]
        Ic:  off-hook loop current [mA]
        Vid: low-power-standby voltage [V]
        Vri: ring voltage [v]
        f:   ring frequency [V]

   config IFX_VOICE_CPE_DXT_COEF_USE_CUSTOM_FILE
      bool "Select own FXS coefficient file"
endchoice

menu "FXS own coefficient file"
    depends on IFX_VOICE_CPE_DXT_COEF_USE_CUSTOM_FILE && PACKAGE_ifx-voice-cpe-tapi-duslic_xt-coef
    config IFX_VOICE_CPE_DXT_COEF_CUSTOM_FILE
    string "FXS own coefficient file"
endmenu
```

## package/feeds/ltq_voice_cpe/ifx-voice-cpe-tapi-duslic_xt/config/Config.in
```kconfig
menu "Advanced configuration (for developers)"
	depends on PACKAGE_ifx-voice-cpe-tapi-duslic_xt

config LTQ_VOICE_DXT_USER_FLAGS
	depends on PACKAGE_ifx-voice-cpe-tapi-duslic_xt
	string "Additional CFLAGS"
	default ""
	help
		Additional CFLAGS for compilation (for developers)

config LTQ_VOICE_DXT_USER_OPTIONS
	depends on PACKAGE_ifx-voice-cpe-tapi-duslic_xt
	string "Additional configure options"
	default ""
	help
		Additional configure options (for developers)

endmenu


config LTQ_VOICE_DXT_GPIO
	depends on PACKAGE_ifx-voice-cpe-tapi-duslic_xt
	bool "Support for DUSLIC-xT GPIO port"
        default n
	help
		Support for control of the DUSLIC-xT GPIO port.
```

## package/feeds/ltq_voice_cpe/ifx-voice-cpe-tapi-lib-nlt/config/Config.in
```kconfig
config  LTQ_VOICE_CPE_LIB_NLT_VMMC
	bool "enable support for VMMC device"
	depends on PACKAGE_ifx-voice-cpe-lib-nlt
		default y if PACKAGE_ifx-voice-cpe-vmmc
	default y
	help
		Option to enable Line Testing support for VMMC device

config  LTQ_VOICE_CPE_LIB_NLT_DXT
	bool "enable support for DXT device"
	depends on PACKAGE_ifx-voice-cpe-lib-nlt
		default y if PACKAGE_ifx-voice-cpe-tapi-duslic_xt
	default y
	help
		Option to enable Line Testing support on DXT device

menu "advanced configuration (for developers)"
   depends on PACKAGE_ifx-voice-cpe-lib-nlt

config  LTQ_VOICE_CPE_LIB_NLT_ADDITIONAL_FLAGS
	string "additional configuration arguments"
	depends on PACKAGE_ifx-voice-cpe-lib-nlt
	default ""
	help
		additional configuration arguments (for developers)

config  LTQ_VOICE_CPE_LIB_NLT_IFXOS_SUPPORT
	bool "enable IFXOS library support"
	depends on PACKAGE_ifx-voice-cpe-lib-nlt
	default n
	help
		Option to enable IFXOS library usage

endmenu
```
