## package/feeds/ltq_voice_cpe/ifx-voice-cpe-tapi/config/Config.in
```kconfig
menu "Advanced configuration (for developers)"
	depends on PACKAGE_ifx-voice-cpe-tapi

config LTQ_VOICE_TAPI_USER_FLAGS
	depends on PACKAGE_ifx-voice-cpe-tapi
	string "Additional CFLAGS"
	default ""
	help
		Additional CFLAGS for compilation (for developers)

config LTQ_VOICE_TAPI_USER_OPTIONS
	depends on PACKAGE_ifx-voice-cpe-tapi
	string "Additional configure options"
	default ""
	help
		Additional configure options (for developers)

config LTQ_VOICE_CPE_TAPI_EVENT_LOGGER
	bool "Event logger support"
	depends on PACKAGE_ifx-voice-cpe-tapi && +PACKAGE_ltq-evtlog
	default n
	help
		Option to capture detailed traces via the event logger module.
		- for debugging only
		- requires package ltq-evtlog.

endmenu

config LTQ_VOICE_CPE_TAPI_FAX
	bool "FAX relay and modem support"
	depends on PACKAGE_ifx-voice-cpe-tapi
	depends on PACKAGE_ifx-voice-cpe-vmmc
	default n
	help
		Option to enable fax/modem support in TAPI.
		Note: Newer platforms as xRX100 and xRX200 support a T.38 fax relay stack
		in FW while older platforms like Danube or VINETIC-CPE require a
		separate SW stack executed as an application.

config LTQ_VOICE_CPE_TAPI_CID
	bool "CID support"
	depends on PACKAGE_ifx-voice-cpe-tapi
	depends on PACKAGE_ifx-voice-cpe-vmmc || PACKAGE_ifx-voice-cpe-tapi-duslic_xt
	default y
	help
		Option to enable Caller ID support.

config LTQ_VOICE_CPE_TAPI_LT_GR909
	bool "Linetesting GR-909 support"
	depends on PACKAGE_ifx-voice-cpe-tapi
	depends on PACKAGE_ifx-voice-cpe-vmmc || PACKAGE_ifx-voice-cpe-tapi-duslic_xt
	default y
	   help
		   Option to enable linetesting GR-909.

config LTQ_VOICE_CPE_TAPI_CONT_MEASUREMENT
	bool "Continuous Analog Line Measurement"
	depends on PACKAGE_ifx-voice-cpe-tapi
	depends on PACKAGE_ifx-voice-cpe-vmmc || PACKAGE_ifx-voice-cpe-tapi-duslic_xt
	default n
	help
		Enable the Continuous Measurement feature on FXS lines.

config LTQ_VOICE_CPE_TAPI_DECT
	bool "DECT encoding for COSIC modem"
	depends on PACKAGE_ifx-voice-cpe-tapi
	depends on PACKAGE_ifx-voice-cpe-vmmc
	select LTQ_VOICE_CPE_TAPI_KPI
	default n
	help
		Option to enable DECT encoding for COSIC modem.

config LTQ_VOICE_CPE_TAPI_QOS
	bool "QOS for accelerated RTP packet handling"
	depends on PACKAGE_ifx-voice-cpe-tapi
	depends on PACKAGE_ifx-voice-cpe-vmmc || PACKAGE_ifx-voice-cpe-tapi-kpi2udp
	select LTQ_VOICE_CPE_TAPI_KPI
	default y
	help
		Option to enable an accelerated RTP packet transfer inside
		the LINUX kernel space. This option requires the KPI2UDP
		packet, which actually provides the OS specific hooks in
		the IP stack.

config LTQ_VOICE_CPE_TAPI_KPI
	bool "KPI (Kernel Packet Interface)"
	depends on PACKAGE_ifx-voice-cpe-tapi
	depends on PACKAGE_ifx-voice-cpe-vmmc || PACKAGE_ifx-voice-cpe-tapi-kpi2udp
	default y
	help
		Option to enable the generic kernel level packet interface
		which allows accelerated packet transfer for various purposes.
		The most important example is the QOS option, which allows
		to redirect RTP packets directly into the IP stack.
		Other options relying on KPI are DECT and HDLC.

config LTQ_VOICE_CPE_TAPI_STATISTICS
	bool "Voice packet counters in /proc fs"
	depends on PACKAGE_ifx-voice-cpe-tapi
	depends on PACKAGE_ifx-voice-cpe-vmmc
	default y
	help
		Option to enable packet counters which can be read via the
		/proc filesystem "statistic" node.

config LTQ_VOICE_CPE_TAPI_METERING
	bool "Metering (TTX) support"
	depends on PACKAGE_ifx-voice-cpe-tapi
	depends on PACKAGE_ifx-voice-cpe-vmmc || PACKAGE_ifx-voice-cpe-tapi-duslic_xt
	default n
	help
		Option to enable metering (TTX) support.

config LTQ_VOICE_CPE_TAPI_PCM
	bool "PCM support"
	depends on PACKAGE_ifx-voice-cpe-tapi
	depends on PACKAGE_ifx-voice-cpe-vmmc || PACKAGE_ifx-voice-cpe-tapi-duslic_xt
	default y
	help
		Enable PCM support.

#config LTQ_VOICE_CPE_TAPI_HDLC
#	bool "PCM HDLC support (evaluation)"
#	depends on PACKAGE_ifx-voice-cpe-tapi
#	depends on LTQ_VOICE_CPE_TAPI_PCM
#	default n
#	help
#		Option to enable PCM HDLC framing inside the firmware, e.g. for
#		ISDN D-Channel access.

config LTQ_VOICE_CPE_TAPI_PHONE_DETECTION
	bool "FXS Phone Detection"
	depends on PACKAGE_ifx-voice-cpe-tapi
	depends on PACKAGE_ifx-voice-cpe-vmmc || PACKAGE_ifx-voice-cpe-tapi-duslic_xt
	default n
	help
		Enable the Phone Detection feature on FXS lines.

config LTQ_VOICE_CPE_TAPI_PMC
	bool "Register with Power Management Control Unit"
	depends on PACKAGE_ifx-voice-cpe-tapi
	default n
	help
		Register with the Power Management Control Unit (PMCU)
		for enable/disable of the power save features and status
		reports of voice-FW activity.

config LTQ_VOICE_CPE_TAPI_HOTPLUG
	bool "Enable Linux hotplug events"
	depends on PACKAGE_ifx-voice-cpe-tapi
	default n
	help
		Enable support for Linux hotplug event feature.

config LTQ_VOICE_CPE_TAPI_TRACES
	bool "Compile with driver traces"
	depends on PACKAGE_ifx-voice-cpe-tapi
	default y
	help
		Enable driver traces with different trace levels to be
		configured dynamically from the application or during insmod
```

## package/feeds/ltq_voice_cpe/ifx-voice-cpe-tapidemo/config/Config.in
```kconfig
choice
   prompt "board selection"
   depends on PACKAGE_ifx-voice-cpe-tapidemo
   default LTQ_VOICE_CPE_TAPIDEMO_BOARD_EASY508xx     if (TARGET_ifxcpe_platform_ar9 || TARGET_ltqcpe_platform_ar9)
   default LTQ_VOICE_CPE_TAPIDEMO_BOARD_XWAY_XRX300   if (TARGET_ltqcpe_platform_ar10)
   default LTQ_VOICE_CPE_TAPIDEMO_BOARD_EASY80910     if (TARGET_ifxcpe_platform_vr9 || TARGET_ltqcpe_platform_vr9)
   default LTQ_VOICE_CPE_TAPIDEMO_BOARD_EASY508xx
   help
      Select the target platform.

   config LTQ_VOICE_CPE_TAPIDEMO_BOARD_EASY508xx
      bool "AR9/GR9 reference board"

   config LTQ_VOICE_CPE_TAPIDEMO_BOARD_XWAY_XRX300
      bool "XWAY(TM) XRX300 Evaluation Board"

   config LTQ_VOICE_CPE_TAPIDEMO_BOARD_EASY80910
      bool "VR9 reference board"
endchoice

menu "advanced configuration (for developers)"
   depends on PACKAGE_ifx-voice-cpe-tapidemo
config  LTQ_VOICE_CPE_TAPIDEMO_ADDITIONAL_FLAGS
	string "additional configuration arguments"
	depends on PACKAGE_ifx-voice-cpe-tapidemo
	default ""
	help
		additional configuration arguments (for developers)
endmenu

config LTQ_VOICE_CPE_TAPIDEMO_QOS
	bool "enable QOS support"
	depends on PACKAGE_ifx-voice-cpe-tapidemo
	default y
	help
		Option to enable the KPI2UDP RTP packet acceleration path
		(highly recommended for VoIP).

config  LTQ_VOICE_CPE_TAPIDEMO_FAX_MODEM
	bool "enable fax/modem transparent support"
	depends on PACKAGE_ifx-voice-cpe-tapidemo
   default y if LTQ_VOICE_CPE_TAPIDEMO_FAX_T_38_FW
	default n
	help
		enable fax/modem transparent support

config  LTQ_VOICE_CPE_TAPIDEMO_FAX_T_38_FW
	bool "enable T.38 fax relay"
	depends on PACKAGE_ifx-voice-cpe-tapidemo && (TARGET_ifxcpe_platform_ar9 || TARGET_ifxcpe_platform_vr9 || TARGET_ltqcpe_platform_ar9 || TARGET_ltqcpe_platform_ar10 || TARGET_ltqcpe_platform_vr9)
	default y
	help
		enable T.38 fax relay demo,
		when enabled then fax/modem transparent support is also enabled

config  LTQ_VOICE_CPE_TAPIDEMO_DXT_EXT
	bool "enable DUSLIC-xT extension board support"
	depends on PACKAGE_ifx-voice-cpe-tapidemo && PACKAGE_ifx-voice-cpe-tapi-duslic_xt && (TARGET_ifxcpe_platform_ar9 || TARGET_ifxcpe_platform_vr9 || TARGET_ltqcpe_platform_ar9 || TARGET_ltqcpe_platform_ar10 || TARGET_ltqcpe_platform_vr9)
	default y
	help
		enable DUSLIC-xT extension board support

config  LTQ_VOICE_CPE_TAPIDEMO_DECT
	bool "enable DECT support"
	depends on PACKAGE_ifx-dect && PACKAGE_ifx-voice-cpe-tapidemo && (TARGET_ifxcpe_platform_ar9 || TARGET_ifxcpe_platform_vr9 || TARGET_ltqcpe_platform_ar9 || TARGET_ltqcpe_platform_ar10 || TARGET_ltqcpe_platform_vr9)
	default y
	help
		enable DECT support.

config LTQ_VOICE_CPE_TAPIDEMO_EVENT_LOGGER
	depends on PACKAGE_ifx-voice-cpe-tapidemo && +PACKAGE_ifx-evtlog
	bool "Event logger support"
	default y
	help
		Option to send traces from Tapidemo to Event Logger
		- for debugging only
		- requires package ifx-evtlog
```

## package/feeds/ltq_voice_cpe/ifx-voice-cpe-vmmc-coef-ar9/config/Config.in
```kconfig
choice
   depends on PACKAGE_ifx-voice-cpe-vmmc-coef-ar9
   prompt "FXS coefficients"
   default LTQ_VOICE_CPE_VMMC_COEF_AR9_ETSI
   help
      Select country specific FXS coefficient file.

   config LTQ_VOICE_CPE_VMMC_COEF_AR9_ETSI
      bool "ETSI_T3R10: Vl:40V, Ic:25mA, Vid:25V, Vri:45Vrms, f:25Hz"	
      help
        These coefficents contains a parameter set with line impedance Zr according to ETSI.
 
        T:   gain in transmit direction (attenuation 3dBr) [dBr]
        R:   gain in receive direction (attenuation 10dBr) [dBr]
        Vl:  on-hook voltage limit [V]
        Ic:  off-hook loop current [mA]
        Vid: low-power-standby voltage [V]
        Vri: ring voltage [v]
        f:   ring frequency [V]

   config LTQ_VOICE_CPE_VMMC_COEF_AR9_US600R
      bool "USA_600R_T3R10: Vl:40V, Ic:25mA, Vid:25V, Vri:45V, f:20Hz"      
      help
        These coefficents contains a parameter set with line impedance e.g. for USA.
 
        T:   gain in transmit direction (attenuation 3dBr) [dBr]
        R:   gain in receive direction (attenuation 10dBr) [dBr]
        Vl:  on-hook voltage limit [V]
        Ic:  off-hook loop current [mA]
        Vid: low-power-standby voltage [V]
        Vri: ring voltage [v]
        f:   ring frequency [V]

   config LTQ_VOICE_CPE_VMMC_COEF_AR9_GERMANY
      bool "GERM_T3R10: Vl:40V, Ic:25mA, Vid:25V, Vri:45Vrms, f:25Hz"
      help
        These coefficents contains a parameter set with line impedance for Germany.
 
        T:   gain in transmit direction (attenuation 3dBr) [dBr]
        R:   gain in receive direction (attenuation 10dBr) [dBr]
        Vl:  on-hook voltage limit [V]
        Ic:  off-hook loop current [mA]
        Vid: low-power-standby voltage [V]
        Vri: ring voltage [v]
        f:   ring frequency [V]

   config LTQ_VOICE_CPE_VMMC_COEF_AR9_USE_CUSTOM_FILE
      bool "Select own FXS coefficient file"
endchoice
    
menu "FXS own coefficient file"
    depends on LTQ_VOICE_CPE_VMMC_COEF_AR9_USE_CUSTOM_FILE && PACKAGE_ifx-voice-cpe-vmmc-coef-ar9
    config LTQ_VOICE_CPE_VMMC_COEF_AR9_CUSTOM_FILE
    string "FXS own coefficient file"
endmenu

choice
   depends on PACKAGE_ifx-voice-cpe-vmmc-coef-ar9
   prompt "FXO coefficients"
   default LTQ_VOICE_CPE_VMMC_COEF_AR9_ETSI_FXO
   help
      Select country specific FXO coefficient file.

   config LTQ_VOICE_CPE_VMMC_COEF_AR9_ETSI_FXO
      bool "ETSI: Tx:0dBr, Rx:0dBr"	
      help
        These coefficents contains a parameter set with line impedance Zr according to ETSI.
 
        Tx:   gain in transmit direction (attenuation 0dBr) [dBr]
        Rx:   gain in receive direction (attenuation 0dBr) [dBr]

   config LTQ_VOICE_CPE_VMMC_COEF_AR9_US600R_FXO
      bool "USA_600R: Tx:0dBr, Rx:0dBr"
      help
        These coefficents contains a parameter set with line impedance e.g. for USA.
 
        Tx:   gain in transmit direction (attenuation 0dBr) [dBr]
        Rx:   gain in receive direction (attenuation 0dBr) [dBr]

   config LTQ_VOICE_CPE_VMMC_COEF_AR9_GERMANY_FXO
      bool "GERM: Tx:0dBr, Rx:0dBr"
      help
        These coefficents contains a parameter set with line impedance for Germany.
 
        Tx:   gain in transmit direction (attenuation 0dBr) [dBr]
        Rx:   gain in receive direction (attenuation 0dBr) [dBr]

   config LTQ_VOICE_CPE_VMMC_COEF_AR9_USE_CUSTOM_FILE_FXO
      bool "Select own FXO coefficient file"
endchoice

menu "FXO own coefficient file"
   depends on LTQ_VOICE_CPE_VMMC_COEF_AR9_USE_CUSTOM_FILE_FXO && PACKAGE_ifx-voice-cpe-vmmc-coef-ar9
   config LTQ_VOICE_CPE_VMMC_COEF_AR9_CUSTOM_FILE_FXO
   string "FXO own coefficient file"
endmenu
```

## package/feeds/ltq_voice_cpe/ifx-voice-cpe-vmmc/config/Config.in
```kconfig
menu "Advanced configuration (for developers)"
	depends on PACKAGE_ifx-voice-cpe-vmmc

config LTQ_VOICE_VMMC_USER_FLAGS
	depends on PACKAGE_ifx-voice-cpe-vmmc
        string "Additional CFLAGS"
        default ""
        help
                Additional CFLAGS for compilation (for developers)

config LTQ_VOICE_VMMC_USER_OPTIONS
	depends on PACKAGE_ifx-voice-cpe-vmmc
        string "Additional configure options"
        default ""
        help
                Additional configure options (for developers)

config LTQ_VOICE_CPE_VMMC_MPS_HISTORY_SIZE
	depends on PACKAGE_ifx-voice-cpe-vmmc
	string "MPS history buffer in words (0<=size<=512)"
	default "128"
	help
		MPS history buffer (default=128 words, maximum=512 words, 0=disable)
		To opimize the memory footprint in RAM, you might want to set the
		buffer size to 0.
endmenu

choice
	depends on PACKAGE_ifx-voice-cpe-vmmc
	prompt "device selection"
	default LTQ_VOICE_CPE_VMMC_WITH_DEVICE_AR9    if (TARGET_ltqcpe_ar9  || TARGET_ltqcpe_platform_ar9 || TARGET_ifxcpe_platform_ar9)
	default LTQ_VOICE_CPE_VMMC_WITH_DEVICE_VR9    if (TARGET_ltqcpe_vr9  || TARGET_ltqcpe_platform_vr9 || TARGET_ifxcpe_platform_vr9)
	default LTQ_VOICE_CPE_VMMC_WITH_DEVICE_XRX300 if (TARGET_ltqcpe_ar10 || TARGET_ltqcpe_platform_ar10)
	help
		Select the target device.

	config LTQ_VOICE_CPE_VMMC_WITH_DEVICE_AR9
		bool "xRX100 family"
		select PACKAGE_ifx-voice-cpe-vmmc-firmware-ar9
		select PACKAGE_ifx-voice-cpe-vmmc-coef-ar9

	config LTQ_VOICE_CPE_VMMC_WITH_DEVICE_VR9
		bool "xRX200 family"
		select PACKAGE_ifx-voice-cpe-vmmc-firmware-vr9
		select PACKAGE_ifx-voice-cpe-vmmc-coef-vr9

	config LTQ_VOICE_CPE_VMMC_WITH_DEVICE_XRX300
		bool "xRX300 family"
		select PACKAGE_ifx-voice-cpe-vmmc-firmware-xRX300
		select PACKAGE_ifx-voice-cpe-vmmc-coef-xRX300
endchoice

config LTQ_VOICE_CPE_VMMC_PMU
	depends on PACKAGE_ifx-voice-cpe-vmmc
	bool "Power Management Unit support"
	default y
	help
		Option to use Power Management Unit functionality.

config LTQ_VOICE_CPE_VMMC_DISABLE_DECT_NIBBLE_SWAP
	depends on PACKAGE_ifx-voice-cpe-vmmc
	bool "disable DECT nibble swap"
	default n
	help
		Option to disable DECT nibble swap for COSIC modem (for backward compatibility only).

config LTQ_VOICE_CPE_VMMC_SSLIC_FXO_ACTIVATE
	depends on PACKAGE_ifx-voice-cpe-vmmc
	bool "Activate SmartSLIC FXO ports upon TAPI init"
	default n
	help
		Option to activate FXO ports connected to a SmartSLIC by default.
                This should be disabled unless there is an FXO chip connected to
                the GPIOs of the SmartSLIC. Otherwise the SmartSLIC may consume
                quite some processor power depending on the signals on the GPIO pins
                of the SmartSLIC.
                Do not set for the LANTIQ xRX100 or xRX200 Family boards.
                Set it for the LANTIQ Compact GW188 and xRX300 Family boards.

config LTQ_VOICE_CPE_VMMC_RTCP_XR
	depends on PACKAGE_ifx-voice-cpe-vmmc
	bool "RTCP Extended Reports (XR) support"
	default y
	help
		Option to enable RTCP Extended Reports (XR) functionality.
```
