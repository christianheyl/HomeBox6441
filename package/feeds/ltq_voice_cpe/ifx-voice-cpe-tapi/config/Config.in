## target/linux/ltqcpe/files-2.6.32/drivers/char/Kconfig.ifx
```kconfig
config IFX_PMCU
	tristate "IFX PMCU"
	depends on !CPU_FREQ && (AR9 || VR9 || DANUBE || AMAZON_SE || AR10 || HN1)
	default y
	---help---
	  Power Management Control Unit has an Ioctl interface to the PMCU_Utility
	  as well as to the Power Management Daemon (PMD). 

config IFX_CPUFREQ
        tristate "CPU Frequency Control unit"
        depends on (IFX_PMCU || CPU_FREQ) && (AR9 || VR9 || AR10 || HN1)
        default y
	---help---
	  Low Level IFX_CPUFREQ driver is used by IFX_PMCU as well as from the 
	  Linux CPU_FREQ driver.

config IFX_PMU
	tristate "IFX Power Management Unit"
	depends on AMAZON_SE || DANUBE || AR9 || VR9 || AR10 || HN1
	default y

config IFX_PMU_POWER_GATING
	bool "IFX PMU Power Gating support"
	depends on IFX_PMU && (VR9 || AR10 || HN1)
	default y

config IFX_GPIO
	bool "IFX GPIO"
	depends on DANUBE || AMAZON_SE || AR9 || VR9 || AR10 || HN1
	default y

config IFX_RCU
	bool "IFX Reset Control Unit"
	depends on  AMAZON_SE || DANUBE || AR9 || VR9 || AR10 || HN1
	default y

config IFX_SI
	tristate "IFX Serial In Controller"
	depends on AR9 || VR9
	default n

config IFX_LEDC
	tristate "IFX LED Controller (Serial Out)"
#	select IFX_GPTU
	depends on DANUBE || AMAZON_SE || AR9 || VR9 || AR10 || HN1
	default y

config IFX_EBU_LED
	bool
	depends on DANUBE
	default n

config IFX_WDT
	bool "IFX Watchdog Timer"
	depends on  AMAZON_SE || DANUBE || AR9 || VR9 || AR10 || HN1
	default y

config IFXMIPS_DSL_CPE_MEI
    tristate "DSL Low Level MEI driver"
	depends on !(VR9 || HN1)
	default n
	---help---
      This is the DSL low level driver for CPE platforms.

config DSL_MEI_CPE_DRV
	tristate "DSL MEI CPE Low Level Driver"
	default n
	---help---
	This is the DSL MEI CPE low level driver for the Vinax/VRx platforms.

config IFX_PMON
	tristate "IFX Performance Monitor <PMON>"
	depends on VR9 || AR10 || HN1
	default n
	---help---
	  PMON should be used with open source pecostat kernel module and pecostat user space tool.

config IFX_DCDC
        tristate "VR9 DCDC driver"
        depends on VR9
        default n
        ---help---
          Turn on this option to have DCDC (voltage scaling) feature.

config IFX_TS
	tristate "Thermal Sensor Driver"
	depends on VR9
	default n
	---help---
	  Turn on this option to enable thermal sensor feature.

config IFX_INA219
	bool "Power Measurement (INA219)"
	depends on AR10
	default n
	---help---
	  Test component to measure power of each segment. May conflict with
	  other peripherals (e.g. DECT, Voice) due to GPIO pins shared with TDM.

############################################################
#  HN project
############################################################
config LTQ_HN_MBMOD
        tristate "Lantiq HN1 mailbox module <MB>"
        depends on HN1
        default y
        ---help---
          MB module manages mailbox between VPEs. All other HN modules depends on MB module.

config LTQ_HN_HNDRV
        tristate "Lantiq HN firmware driver module <HN>"
        depends on HN1
        default y
        ---help---
          HN driver module manages HN1 firmware.

config LTQ_HN_VPELAUNCHER
        tristate "Lantiq HN1 VPE launcher"
        depends on HN1
        default n
        ---help---
          VPE launcher module launchers VPE1.

config LTQ_HN_PUSH
        tristate "Lantiq HN1 push button driver"
        depends on HN1
        default y
        ---help---
          Push button driver(for WPS)
```

## target/linux/ltqcpe/files-2.6.32/drivers/i2c/busses/Kconfig.ifx
```kconfig
config LTQ_I2C
	tristate "Lantiq I2C Interface"
	depends on (HN1)
	default y
	help
	  If you say yes to this option, support will be included for the
	  built-in I2C interface on some Lantiq devices.
```

## target/linux/ltqcpe/files-2.6.32/drivers/mmc/host/Kconfig.ifx
```kconfig
config IFX_MMC
	tristate "IFX MMC host Interface Support"
	depends on ((AR9 || DANUBE || AMAZON_SE || VR9) && MMC)
	default n
```

## target/linux/ltqcpe/files-2.6.32/drivers/mtd/nand/Kconfig.ifx
```kconfig
config MTD_IFX_NAND_LATCH_ENABLE
        bool "Enable Latch mode in the NAND drivers"
        depends on MTD_IFX_NAND || MTD_IFX_HSNAND || MTD_IFX_MLCNAND
        default y
        help
           This option enables Latch mode in our drivers. Unselect this option if
           you are using pulse mode. If unsure, leave this option selected

config MTD_IFX_NAND
    tristate "IFX MTD NAND Flash Driver"
	depends on MTD_NAND && (AMAZON_SE || DANUBE || AR9 || VR9 || HN1 || AR10) && !(MTD_IFX_MLCNAND)
	default y
		
config MTD_IFX_NAND_FLASH_SIZE
    int "Maximum size for IFX flash area (MB)"
	depends on MTD_IFX_NAND && !(MTD_CMDLINE_PARTS) 
	default "4"

config MTD_IFX_HSNAND
     tristate "IFX MTD HSNAND Flash Driver"
	depends on MTD_NAND &&  VR9
	default n

config MTD_IFX_HSNAND_FLASH_SIZE
    int "Maximum size for IFX flash area (MB)"
	depends on MTD_IFX_HSNAND && !(MTD_CMDLINE_PARTS) && VR9
	default "4"

config MTD_IFX_MLCNAND
     tristate "IFX MTD MLCNAND Flash Driver"
        depends on MTD_NAND &&  AR10
        default n

config MTD_IFX_MLCNAND_FLASH_SIZE
     int "Maximum size for IFX flash area (MB)"
        depends on MTD_IFX_MLCNAND && !(MTD_CMDLINE_PARTS) && AR10
        default "4"

#MLC NAND Config values

if MTD_IFX_MLCNAND

choice
	prompt "Mode for ECC Location"

config MTD_MLC_EMBEDDED_MODE
	bool "ECC is embedded into the data in a page"
	help 
	    ECC is embedded into data sector. Fixed to 124B+4B ECC.
	    Compatible to only 4-Byte ECC mode

config MTD_MLC_SPARE_MODE
	bool "ECC is embedded into the first 3/4 bytes of the spare area"
	help
	    ECC is automatically embedded to the end of the page
endchoice


choice
	prompt "ECC bytes algorithm mode"

config MTD_MLC_ECC_4B_MODE
	bool "4 byte ECC mode"
	help 
	    This mode allows 4-byte ECC algorithm to be used.

if MTD_MLC_SPARE_MODE
config MTD_MLC_ECC_3B_MODE
        bool "3 bytes ECC mode"
	help
            This mode allows 3-byte ECC algorithm to be used.
endif
endchoice

choice
	prompt "NAND controller ECC strength"

config MTD_MLC_SAFE_MODE
	bool "Safe ECC Mode"
	help 
	    This mode ensures that in 3 Byte ECC mode all
            1-bit errors are detected & corrected. In 4 Byte ECC mode all 2-bit
            errors are detected & corrected. For both cases higher bit errors are
            detected with 99% probability (Safe Mode). [Default after reset)

config MTD_MLC_ADVANCE_MODE
	bool "Advance ECC Mode"
	help
	    ECC mode. In 3 Byte ECC mode up to 2-bit errors will
            be detected & corrected with 98% probability. In 4 Byte ECC mode
            up to 3-bit errors will be detected & corrected with 95% probability.
            For higher bit errors the probability of detection is 70%
endchoice


endif

if AR10 && (MTD_IFX_MLCNAND || MTD_IFX_NAND)

choice 	
	prompt "Chip select for MLC Nand flash"

config NAND_CS0
        bool "MLC NAND connected to CS0"
config NAND_CS1
        bool "MLC NAND connected to CS1"

endchoice
endif
```

## target/linux/ltqcpe/files-2.6.32/drivers/net/ifxmips_ppa/Kconfig
```kconfig
config IFX_PPA
	bool "PPA Acceleration Package"
	depends on NET_ETHERNET
	default n
	help
	  Acceleration Package Support

config IFX_PPA_API
	tristate "PPA Acceleration Package - Kernel APIs"
	depends on IFX_PPA && IFX_PPA_DATAPATH
	default y
	help
	  PPA APIs and Kernel Hookup

config LTQ_MINI_JUMBO_FRAME_SUPPORT
	tristate "Mini Jumbo Frame support"
	depends on IFX_PPA 
	default n
	help
	  Mini Jumbo Frame support

config IFX_PPA_API_DIRECTPATH
	bool "Direct Path Support for PPA API"
	depends on IFX_PPA_API
	default y
	help
	  Direct Path Support (e.g. WLAN) for PPA API

config IFX_PPA_API_DIRECTPATH_BRIDGING
	bool "Bridging Support in Direct Path"
	depends on IFX_PPA_API_DIRECTPATH
	default y
	help
	  Let PPA accelerate bridging traffic. (Not good performance in D4/A4)

choice
	prompt "Software TX Queue"
	depends on IFX_PPA_API_DIRECTPATH
	default IFX_PPA_DIRECTPATH_TX_QUEUE_NONE

config IFX_PPA_DIRECTPATH_TX_QUEUE_NONE
	bool "No Support"
	help
	  Do not support Directpath Software TX Queue.

config IFX_PPA_DIRECTPATH_TX_QUEUE_SIZE
	bool "Queue Length - 1524 x 50 bytes"
	help
	  TX queue length is counted in total bytes of all packets in queue.
	  It provides better performance while handling burst traffic, if the
	  size of packets is random. Default value is 1524 x 50 bytes and can
	  be changed with parameter "directpath_tx_queue_size" passed in kernel
	  command line or loadable module parameter.

config IFX_PPA_DIRECTPATH_TX_QUEUE_PKTS
	bool "Queue Length - 50 packets"
	help
	  TX queue length is counted in number of packets in queue. It provides
	  less overhead with acceptable performance while handling burst
	  traffic. Default value is 50 packets and can be changed with parameter
	  "directpath_tx_queue_pkts" passed in kernel command line or loadable
	  module parameter.
config IFX_PPA_DIRECTPATH_TX_IMQ
	bool "Use IMQ for Directpath Rateshaping"
	help
	  Use IMQ to do Directpath Rateshaping to solve burst issue
endchoice

config IFX_PPA_API_DIRECTPATH_TASKLET
	bool "Directpath use tasklet on TX queue"
	depends on IFX_PPA_API_DIRECTPATH && (IFX_PPA_DIRECTPATH_TX_QUEUE_SIZE || IFX_PPA_DIRECTPATH_TX_QUEUE_PKTS)
	help
        Directpath use tasklet to send frames from registered device.

config IFX_PPA_API_PROC
	tristate "Proc Filesystem Support for PPA API"
	depends on IFX_PPA_API
	default y
	help
	  Proc Filesystem Support for PPA API

config IFX_PPA_MFE
        bool "Multiple Filed Classification and Vlan Editing"
        depends on IFX_PPA_API
        default n
        help
          Multiple Field Classification and Vlan Editing feature PPA API

config IFX_PPA_QOS
        bool "QOS"
        depends on IFX_PPA_API
        default y
        help
          QOS support

config IFX_PPA_QOS_WFQ
        bool "QOS WFQ"
        depends on IFX_PPA_QOS
        default y
        help
          QOS WFQ support

config IFX_PPA_QOS_RATE_SHAPING
        bool "QOS Rate Shaping"
        depends on IFX_PPA_QOS
        default y
        help
          QOS Rate Shaping support

config IFX_PPA_IPv6_ENABLE
	bool "PPA IPv6 support"
	depends on IFX_PPA_API
	default y

config IFX_PPA_DATAPATH
	tristate "PPA Acceleration Package - Data Path Driver"
	depends on IFX_PPA
	default y
	select IFX_ETH_FRAMEWORK
	help
	  PPA Low Level Driver (Data Path)

menu "Package Selection"
	depends on IFX_PPA_DATAPATH

config IFX_PPA_A5
	bool "PPA A5 Package <MII0/1 + ATM>"
	depends on AR9 || VR9 || AR10
	default n

config IFX_PPA_D5
	bool "PPA D5 Package <MII0/1>"
	depends on AR9 || VR9 || AR10
	default n

config IFX_PPA_E5
	bool "PPA E5 Package <MII0/1 + PTM>"
	depends on AR9 || VR9 || AR10
	default n

config IFX_PPE_E5_OFFCHIP_BONDING
	bool "PPA E5 Off-chip Bonding Support"
	depends on VR9
	select IFX_PPA_E5
	default n

config IFX_PPA_VRX218_A1
	bool "VRX218 ATM Module"
	depends on VRX318_PCIE_EP && (VR9 || AR10)
	select IFX_PPA_D5
	default n

config IFX_PPA_VRX218_E1
	bool "VRX218 PTM Module"
	depends on VRX318_PCIE_EP && (VR9 || AR10)
	select IFX_PPA_D5
	default n

endmenu

config SUPPORT_PMAC_FLOWCONTROL
	bool "Enable PMAC flow control"
	depends on AR10 || VR9
	default n

config GRX390_MM_ENHANCE
	bool "Use GRX390 Memory Enhance feature,(GRX390 Only)"
	depends on AR10 || VRX318
	default n

config ACCL_11AC
	tristate "Support Acceleration Qualcomm 11ac"
	depends on GRX390_MM_ENHANCE
	default n

config VRX218_DSL_DFE_LOOPBACK
	bool "SmartPHY DSL DFE Loopback Mode (PPA Testing Only)"
	depends on IFX_PPA_VRX218_A1 || IFX_PPA_VRX218_E1
	default n

config DSL_DFE_LOOPBACK
	tristate "AR10 DSL DFE Loopback Mode (PPA Testing Only)"
	depends on IFX_PPA && AR10
	default n

config LOOP_ETH_DEV
	tristate "Loopback ETH Emulation Device(PPA Testing Only)"
	depends on IFX_PPA
	default n

config IFX_PORT_MIRROR
	bool "Port Mirror support (Debugging Feature)"
	depends on IFX_PPA
	default y
	help
	  Port mirror support.

config PTM_VECTORING
	tristate "PTM Vectoring Error Report Support"
	default n

config IFX_PPA_PORT_SEPARATION
	bool "Port Seperation support"
	default n
```

## target/linux/ltqcpe/files-2.6.32/drivers/net/ifxmips_ppa/Kconfig.swaccl
```kconfig
config LTQ_PPA_API_SW_FASTPATH
          bool "Software Fastpath for PPA API"
          depends on IFX_PPA_API
          default y
          help
            Software Fastpath Support for PPA API (To accelerate PPA sessions that are not in PPE)
```
