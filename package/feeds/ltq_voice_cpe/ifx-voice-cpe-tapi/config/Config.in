## package/feeds/ltq_voice_cpe/ifx-voice-cpe-wineasy/config/Config.in
```kconfig
choice
   prompt "board selection"
   depends on PACKAGE_ifx-voice-cpe-wineasy
   default LTQ_VOICE_CPE_WINEASY_BOARD_EASY508xx     if (TARGET_ltqcpe_ar9  || TARGET_ltqcpe_platform_ar9 || TARGET_ifxcpe_platform_ar9)
   default LTQ_VOICE_CPE_WINEASY_BOARD_EASY80910     if (TARGET_ltqcpe_vr9  || TARGET_ltqcpe_platform_vr9 || TARGET_ifxcpe_platform_vr9)
   default LTQ_VOICE_CPE_WINEASY_BOARD_XWAY_XRX300   if (TARGET_ltqcpe_ar10 || TARGET_ltqcpe_platform_ar10)
   default LTQ_VOICE_CPE_WINEASY_BOARD_EASY508xx
   help
      Select the target platform.

   config LTQ_VOICE_CPE_WINEASY_BOARD_EASY508xx
      bool "EASY508xx XWAY(TM) XRX100 Family Board"

   config LTQ_VOICE_CPE_WINEASY_BOARD_EASY80910
      bool "EASY809xx XWAY(TM) XRX200 Family Board"

   config LTQ_VOICE_CPE_WINEASY_BOARD_XWAY_XRX300
      bool "EASY3xx XWAY(TM) XRX300 Family Board"

endchoice

config  LTQ_VOICE_CPE_WINEASY_DXT_EXT
	bool "enable DUSLIC-xT extension board support"
	depends on PACKAGE_ifx-voice-cpe-wineasy
	depends on PACKAGE_ifx-voice-cpe-tapi-duslic_xt
	default y
	help
		enable DUSLIC-xT extension board support


menu "Advanced configuration (for developers)"
	depends on PACKAGE_ifx-voice-cpe-wineasy

config  LTQ_VOICE_CPE_WINEASY_ADDITIONAL_FLAGS
	string "additional configuration arguments"
	depends on PACKAGE_ifx-voice-cpe-wineasy
	default ""
	help
		additional configuration arguments (for developers)

config  LTQ_VOICE_CPE_WINEASY_IFXOS_SUPPORT
	bool "enable IFXOS library support"
	depends on PACKAGE_ifx-voice-cpe-wineasy
	default n
	help
		Option to enable IFXOS library usage

endmenu
```

## package/feeds/ltq_voice_cpe/teridian-voice-daa-ter1x66/config/Config.in
```kconfig
choice
   prompt "board selection"
   depends on PACKAGE_teridian-voice-daa-ter1x66
   default TERIDIAN_DAA_BOARD_EASY50712_V3  if (TARGET_ifxcpe_platform_danube || TARGET_ltqcpe_platform_danube)
   default TERIDIAN_DAA_BOARD_EASY508xx     if (TARGET_ifxcpe_platform_ar9 || TARGET_ltqcpe_platform_ar9)
   default TERIDIAN_DAA_BOARD_VR9           if (TARGET_ifxcpe_platform_vr9 || TARGET_ltqcpe_platform_vr9)
   default TERIDIAN_DAA_BOARD_EASY50812
   help
      Select the target board.

   config TERIDIAN_DAA_BOARD_EASY50712
      bool "Danube reference board"

   config TERIDIAN_DAA_BOARD_EASY50712_V3
      bool "Danube reference board V3"

   config TERIDIAN_DAA_BOARD_EASY508xx
      bool "AR9/GR9 reference board"

   config TERIDIAN_DAA_BOARD_VR9
      bool "VR9 reference board"
endchoice

config TERIDIAN_DAA_TRACE
	depends on PACKAGE_teridian-voice-daa-ter1x66
	bool "enable traces"
	default y

config TERIDIAN_DAA_ENFORCE_POLLING
    depends on PACKAGE_teridian-voice-daa-ter1x66
    bool "enforce polling mode"
	default n
	help
	    Override the platform settings from drv_config_user.h
		e.g. for debugging purposes to increase the load on the
		SPI bus.
```

## package/mtd/Config.in
```kconfig
menu "Configuration"
	depends on PACKAGE_mtd

	menu "optional: use customized TRX_MAGIC "
		depends on PACKAGE_mtd
	config mtd_USE_CUSTOMIZED_TRX_MAGIC
		bool "Use customized TRX_MAGIC"
		default n
		help
		  During FW upgrade, TRX_MAGIC in fw first 4 bytes would be checked.
		  If mismatch, system would refuse to upgrade this image.
		  (By default, TRX_MAGIC=0x30524448. If want to change to other magic, please enabled.)

	config mtd_CUSTOMIZED_TRX_MAGIC
		depends on mtd_USE_CUSTOMIZED_TRX_MAGIC
		string "Input CUSTOMIZED_TRX_MAGIC in hex form."
		help
		  By default, TRX_MAGIC=0x30524448. If want to change to other magic, please input here.
	endmenu
endmenu
```

## target/linux/ltqcpe/files-2.6.32/arch/mips/Kconfig.ifx
```kconfig
config DANUBE
	bool "Danube Family"
	select SYS_HAS_CPU_MIPS32_R1
	select SYS_HAS_CPU_MIPS32_R2
	select CPU_MIPSR2_IRQ_VI
	select CPU_MIPSR2_SRS
	select SYS_SUPPORTS_32BIT_KERNEL
	select SYS_SUPPORTS_100HZ
	select SYS_SUPPORTS_1000HZ
	select SYS_SUPPORTS_BIG_ENDIAN
	select DMA_NONCOHERENT
	select BOOT_ELF32
	select IRQ_CPU
	select CEVT_R4K
	select CSRC_R4K
	select HW_HAS_PCI
#	select SWAP_IO_SPACE
	help
	  This enables support for the Infineon Technologies Danube chip family.

if DANUBE

menu "Danube Boards"
choice
	prompt "Board Type"

config DANUBE_REF_BOARD
	bool "Danube Reference Board"

endchoice
endmenu

menu "Extra Configuration"

config IFX_DMA_DESCRIPTOR_NUMBER
	int "DMA descript number"
	default "32"
	help
	  This option will assign DMA descriptor number

config NAPI_ENABLED
	bool "Enable NAPI Implementation (USE WITH CAUTION)"
	default yes
	help
	  This option will enable NAPI support for IFX

config DMA_HW_POLL_DISABLED
	bool "Disable DMA HW polling mode, use interrupt mode"
	default no
	help
	  This option will disable DMA HW polling for IFX, and use interrupt mode.

endmenu

endif  # DANUBE

config AMAZON_SE
	bool "Amazon-SE Family"
	select SYS_HAS_CPU_MIPS32_R1
	select SYS_HAS_CPU_MIPS32_R2
	select CPU_MIPSR2_IRQ_VI
	select CPU_MIPSR2_SRS
	select SYS_SUPPORTS_32BIT_KERNEL
	select SYS_SUPPORTS_100HZ
	select SYS_SUPPORTS_1000HZ
	select SYS_SUPPORTS_BIG_ENDIAN
	select DMA_NONCOHERENT
	select BOOT_ELF32
	select IRQ_CPU
	select CEVT_R4K
	select CSRC_R4K
#	select SWAP_IO_SPACE
	select USB_ARCH_HAS_HCD
	help
	  This enables support for the Infineon Technologies Amazon-SE chip
	  family.

if AMAZON_SE

menu "Amazon-SE Boards"
choice
	prompt "Board Type"

config AMAZON_SE_REF_BOARD
	bool "Amazon-SE Reference Board"

endchoice
endmenu

menu "Extra Configuration"

config IFX_DMA_DESCRIPTOR_NUMBER
	int "DMA descript number"
	default "32"
	help
	  This option will assign DMA descriptor number

config NAPI_ENABLED
	bool "Enable NAPI Implementation (USE WITH CAUTION)"
	default yes
	help
	  This option will enable NAPI support for IFX

config DMA_HW_POLL_DISABLED
	bool "Disable DMA HW polling mode, use interrupt mode"
	default no
	help
	  This option will disable DMA HW polling for IFX, and use interrupt mode.

endmenu

endif  # AMAZON_SE

config AR9
	bool "AR9 Family"
	select SYS_HAS_CPU_MIPS32_R1
	select SYS_HAS_CPU_MIPS32_R2
	select CPU_MIPSR2_IRQ_VI
	select CPU_MIPSR2_SRS
	select SYS_SUPPORTS_32BIT_KERNEL
	select SYS_SUPPORTS_100HZ
	select SYS_SUPPORTS_1000HZ
	select SYS_SUPPORTS_BIG_ENDIAN
	select SYS_SUPPORTS_MULTITHREADING
	select DMA_NONCOHERENT
	select BOOT_ELF32
	select IRQ_CPU
	select CEVT_R4K
	select CSRC_R4K
	select HW_HAS_PCI
#	select SWAP_IO_SPACE	# Atheros driver need turn on, USB driver need turn off, after discuss with Mars, disable this item, and Atheros promise to fix it in WLAN driver
	select USB_ARCH_HAS_HCD
	help
	  This enables support for the Infineon Technologies AR9 chip family.

if AR9

menu "AR9 Boards"
choice
	prompt "Board Type"

config AR9_REF_BOARD
	bool "AR9 Reference Board"

config AR9_CUSTOM_BOARD
	bool "AR9 Customer Board"

endchoice

config IFX_GW188
        bool "Indicate if it is GW188 board"
        default no
        help
          This option will indicate the GW188 board

config LTQ_VB300
	bool "Indicate if it is VB300 board"
	default no
	help
	  This option will indicate the VB300 board

endmenu

menu "Extra Configuration"

config IFX_DMA_DESCRIPTOR_NUMBER
	int "DMA descript number"
	default "32"
	help
	  This option will assign DMA descriptor number

config NAPI_ENABLED
	bool "Enable NAPI Implementation (USE WITH CAUTION)"
	default yes
	help
	  This option will enable NAPI support for IFX

config DMA_HW_POLL_DISABLED
	bool "Disable DMA HW polling mode, use interrupt mode"
	default no
	help
	  This option will disable DMA HW polling for IFX, and use interrupt mode.

config IFX_CLOCK_CHANGE
	bool "Clock Frequency Changes on The Fly"
	default yes
	help
	  This option enable CPU/DDR/FPI clock change on the fly.

endmenu

endif  # AR9

config VR9
	bool "VR9 Family"
	select SYS_HAS_CPU_MIPS32_R1
	select SYS_HAS_CPU_MIPS32_R2
	select CPU_MIPSR2_IRQ_VI
	select CPU_MIPSR2_SRS
	select SYS_SUPPORTS_32BIT_KERNEL
	select SYS_SUPPORTS_100HZ
	select SYS_SUPPORTS_1000HZ
	select SYS_SUPPORTS_BIG_ENDIAN
	select SYS_SUPPORTS_MULTITHREADING
        select CPU_SUPPORTS_CPUFREQ
	select DMA_NONCOHERENT
	select BOOT_ELF32
	select IRQ_CPU
	select CEVT_R4K
	select CSRC_R4K
	select HW_HAS_PCI
#	select SWAP_IO_SPACE
	select USB_ARCH_HAS_HCD
	help
	  This enables support for the Infineon Technologies VR9 chip family.

if VR9

menu "VR9 Boards"
choice
	prompt "Board Type"

config VR9_REF_BOARD
	bool "VR9 Reference Board"

endchoice

config LTQ_RT288
	bool "Indicate if it is RT288 board"
	default no
	help
	  This option will indicate the RT288 board

endmenu

menu "Extra Configuration"

config IFX_DMA_DESCRIPTOR_NUMBER
	int "DMA descript number"
	default "32"
	help
	  This option will assign DMA descriptor number

config NAPI_ENABLED
	bool "Enable NAPI Implementation (USE WITH CAUTION)"
	default yes
	help
	  This option will enable NAPI support for IFX

config DMA_HW_POLL_DISABLED
	bool "Disable DMA HW polling mode, use interrupt mode"
	default no
	help
	  This option will disable DMA HW polling for IFX, and use interrupt mode.

config DMA_PACKET_ARBITRATION_ENABLED
	bool "Enable DMA Packet Arbitration"
	default yes
	help
	  This option will enable packet arbitration, which improves DMA overall performance. VR9 A14b requires DDR auto refresh mode 1, which issue auto refresh on the next command boundary to avoid hang issue. VR9 A21 does not have this prerequisite.

config IFX_CLOCK_CHANGE
	bool "Clock Frequency Changes on The Fly"
	default yes
	help
	  This option enable CPU/DDR/FPI clock change on the fly.

config GRX_25M_MODEL
	bool "GRX 25M Model"
	default no
	help
	   Enable this option with GRX Model.

config LTQ_VRX220
        bool "VRX220 Support"
    	default no
	help
	  VRX220 support.


endmenu 

endif  # VR9

config HN1
	bool "HNX100 Family"
	select SYS_HAS_CPU_MIPS32_R1
	select SYS_HAS_CPU_MIPS32_R2
	select CPU_MIPSR2_IRQ_VI
	select CPU_MIPSR2_SRS
	select SYS_SUPPORTS_32BIT_KERNEL
	select SYS_SUPPORTS_100HZ
	select SYS_SUPPORTS_1000HZ
	select SYS_SUPPORTS_BIG_ENDIAN
	select SYS_SUPPORTS_MULTITHREADING
	select DMA_NONCOHERENT
	select BOOT_ELF32
	select IRQ_CPU
	select CEVT_R4K
	select CSRC_R4K
	select HW_HAS_PCI
	select USB_ARCH_HAS_HCD
	help
	  This enables the support for the Lantiq HNX100 chip family.

if HN1

menu "HNX Boards"
choice
	prompt "Board Type"
	default HN1_EVAL_BOARD

config HN1_EVAL_BOARD
	bool "HNX Evaluation Board"

config HN1_REF_BOARD
	bool "HNX Reference Board"

endchoice
endmenu

menu "Extra Configuration"

config IFX_DMA_DESCRIPTOR_NUMBER
	int "DMA descript number"
	default "32"
	help
	  This option assigns DMA descriptor number

config NAPI_ENABLED
	bool "Enable NAPI Implementation (USE WITH CAUTION)"
	default yes
	help
	  This option enables NAPI support 

config DMA_HW_POLL_DISABLED
	bool "Disable DMA HW polling mode, use interrupt mode"
	default no
	help
	  This option disables DMA HW polling for IFX, and use interrupt mode.

config DMA_PACKET_ARBITRATION_ENABLED
	bool "Enable DMA Packet Arbitration"
	default yes
	help
	  This option enables packet arbitration, which improves DMA overall performance.

config IFX_CLOCK_CHANGE
	bool "Clock Frequency Changes on The Fly"
	default no
	help
	  This option enables CPU/DDR/FPI clock change on the fly.

endmenu

endif  # HN1

config AR10
	bool "AR10 Family"
	select SYS_HAS_CPU_MIPS32_R1
	select SYS_HAS_CPU_MIPS32_R2
	select CPU_MIPSR2_IRQ_VI
	select CPU_MIPSR2_SRS
	select SYS_SUPPORTS_32BIT_KERNEL
	select SYS_SUPPORTS_100HZ
	select SYS_SUPPORTS_1000HZ
	select SYS_SUPPORTS_BIG_ENDIAN
	select SYS_SUPPORTS_MULTITHREADING
	select DMA_NONCOHERENT
	select BOOT_ELF32
	select IRQ_CPU
	select CEVT_R4K
	select CSRC_R4K
	select HW_HAS_PCI
	select USB_ARCH_HAS_HCD
	help
	  This enables support for the Infineon Technologies AR10 chip family.

if AR10

menu "AR10 Boards"
choice
	prompt "Board Type"

config AR10_REF_BOARD
	bool "AR10 Reference Board"

endchoice
endmenu

menu "AR10 Boards Family"
choice
	prompt "Board Revision"

config AR10_EVAL_BOARD
	bool "AR10 Eval Board"

config AR10_FAMILY_BOARD_1_1
	bool "AR10 Family Board V1.1"

config AR10_FAMILY_BOARD_1_2
	bool "AR10 Family Board V1.2"

if AR10_FAMILY_BOARD_1_2

menu "Family Board Extension"
choice
	prompt "Target board selection"
	default TARGET_UNDEFINED

config TARGET_MGL7016AW_22_ZZ_R0B
	bool "MGL7016AW_22_ZZ_R0B"

config TARGET_UNDEFINED
	bool "Unknown TARGET"

endchoice
endmenu

endif # AR10_FAMILY_BOARD_1_2

config AR10_FAMILY_BOARD_2
	bool "AR10 Family Board 2"

endchoice
endmenu

menu "XRX300 Boards Extension"
choice
	prompt "Board Extension"
	default NO_BOARD_EXTENSION
config EASY_388_BOND_EXTENSION
        bool "EASY_388_BOND_EXTENSION"
config EASY_3X0_BOND_EXTENSION
        bool "EASY_3X0_BOND_EXTENSION"
config NO_BOARD_EXTENSION
        bool "NO_BOARD_EXTENSION"
endchoice
endmenu

menu "Emulator Support"
config USE_EMULATOR
	bool "Support for FPGA emulation platform"
	default no
	help
	  Use FPGA emulator as platform

choice
	prompt "Emulator"
	depends on USE_EMULATOR
	default USE_VENUS

config USE_VENUS
	bool "Venus"

config USE_PALLADIUM
	bool "Palladium"

endchoice
endmenu

menu "Extra Configuration"

config IFX_DMA_DESCRIPTOR_NUMBER
	int "DMA descript number"
	default "32"
	help
	  This option will assign DMA descriptor number

config NAPI_ENABLED
	bool "Enable NAPI Implementation (USE WITH CAUTION)"
	default yes
	help
	  This option will enable NAPI support for IFX

config DMA_HW_POLL_DISABLED
	bool "Disable DMA HW polling mode, use interrupt mode"
	default no
	help
	  This option will disable DMA HW polling for IFX, and use interrupt mode.

config DMA_PACKET_ARBITRATION_ENABLED
	bool "Enable DMA Packet Arbitration"
	default yes
	help
	  This option will enable packet arbitration, which improves DMA overall performance.

config IFX_CLOCK_CHANGE
	bool "Clock Frequency Changes on The Fly"
	default yes
	help
	  This option enable CPU/DDR/FPI clock change on the fly.

config AR10_GRX390
        bool "GRX390 Support"
    	default no
	help
	  GRX390 support.

endmenu

endif  # AR10
```

## target/linux/ltqcpe/files-2.6.32/drivers/atm/Kconfig.ifx
```kconfig
config IFX_ATM
	tristate "IFX ATM driver"
	depends on (DANUBE || AMAZON_SE || AR9 || VR9 || AR10) && ATM && IFX_PPA_DATAPATH != y
	default n
	---help---
	Use this exclusively with PTM mode or Acceleration Package

config IFX_ATM_TASKLET
	bool "Support Tasklet"
	depends on IFX_ATM
	default y
	---help---
	Use tasklet handle incoming packet. Impact on ATM RX traffic performance.

config IFX_ATM_RETX
	bool "Support ReTX"
	depends on IFX_ATM && (DANUBE || AR9 || AR10)
	default n
	---help---
	Support Retransmission.
```
