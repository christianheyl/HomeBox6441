## target/linux/ltqcpe/files-2.6.32/drivers/net/ifxmips_switch_api/Kconfig
```kconfig
#
# switch api configuration
#
config IFX_ETHSW_API
    tristate "Lantiq Ethernet Switch API"
    default y
    help
    Support for Lantiq Ethernet Switch API.

choice
    prompt "Support Switch API Setting"
    depends on (IFX_ETHSW_API && AR9)
    default EXTERNAL_T3G

config BOTH_INTERFACE
    bool "Both Internal and External"

config INTERNAL_AR9
    bool "Internal TANTOS"

config EXTERNAL_T3G
    bool "External TANTOSxG"
endchoice

menu LQ_ETHSW_API_OPTIONS
 
config LTQ_8021X
	depends on (IFX_ETHSW_API && (AR9 || DANUBE || AMAZON_SE || VR9 || AR10 || HN1))
	default y
	bool "Support LTQ 8021X Switch API's"
    help
    Supported LTQ 8021X based API's

config LTQ_MULTICAST
	depends on (IFX_ETHSW_API && (AR9 || DANUBE || AMAZON_SE || VR9 || AR10 || HN1))
	default y
	bool "Support LTQ MULTICAST Switch API's"
    help
    Supported LTQ MULTICAST based API's
    
config LTQ_QOS
	depends on (IFX_ETHSW_API && (AR9 || DANUBE || AMAZON_SE || VR9 || AR10 || HN1))
	default y
	bool "Support LTQ QOS Switch API's"
    help
    Supported LTQ QOS based API's
    
config LTQ_STP
	depends on (IFX_ETHSW_API && (AR9 || DANUBE || AMAZON_SE || VR9 || AR10 || HN1))
	default y
	bool "Support LTQ STP Switch API's"
    help
    Supported LTQ STP based API's
    
config LTQ_VLAN
	depends on (IFX_ETHSW_API && (AR9 || DANUBE || AMAZON_SE|| VR9 || AR10 || HN1))
	default y
	bool "Support LTQ VLAN Switch API's"
    help
    Supported LTQ VLAN based API's

config LTQ_WOL
	depends on (IFX_ETHSW_API && (AR9 || DANUBE || AMAZON_SE || VR9 || AR10 || HN1))
	default y
	bool "Support LTQ WOL Switch API's"
    help
    Supported LTQ WOL based API's
endmenu

config IFX_ETHSW_API_COC 
    bool "Switch API CoC support"
    depends on (IFX_ETHSW_API && (AR9 || DANUBE || AMAZON_SE || VR9))
    default y
    help
    Supported Tantos xG/VR9 platform

config IFX_ETHSW_API_COC_PMCU
    bool "Switch API CoC PMCU module support"
    depends on (IFX_ETHSW_API && (IFX_PMCU || CPU_FREQ) && (AR9 || DANUBE || AMAZON_SE ||VR9 ))
    default y
    help
    Supported Tantos xG/VR9 platform

config AMAZON_SE_TANTOS0G_GPIO
    bool "Amazon_SE Tantos0G GPIO access "
    depends on (AMAZON_SE && IFX_ETHSW_API && ASE_SWITCH_GPIO_ACCESS)
    default y
    help
    Supported AMAZON_SE only

config LTQ_SWITCH_VPE1
	bool "Execute Switch VPE1 code from VPE1"
	depends on HN1
	default y
	help
	Execute Switch Driver from VPE1. The Switch API wrapper driver on Linux VPE0 feeds a VPE1 mailbox for Switch API accesses.

#choice
#    prompt " API Support "
#    depends on ( (VR9 || AR10 || HN1) && IFX_ETHSW_API)
#    default LTQ_GSWIP	
    
#  config LTQ_GSWIP
#	bool " LTQ Gigabit Switch (GSWIP -->VR2xx/AR3xx/G.Hn)"
#endchoice

config GPHY_DRIVER 
    depends on (VR9 || AR10 || HN1)
    default y
    tristate "VR9/AR10/HN1 Internal GPHY support"
    help
    Supported Internal GPHY driver for VR9/AR10 platform

menu GPHY_DRIVER_OPTIONS

choice
    prompt "GE/SE MODE Select"
    depends on ( ( VR9  || AR10 || HN1 ) && GPHY_DRIVER)
    default GE_MODE

config GE_MODE
    bool "Giga Ethernet Mode"

config FE_MODE
    bool "Fast Ethernet Mode"

config GEFE_MIXED_MODE
    bool "Giga/Fast Mixed Ethernet Mode"
endchoice

config FW_LOAD_FROM_USER_SPACE 
    depends on ( (VR9 || AR10 ) && GPHY_DRIVER )
    default n
    bool "Download FW from User Level "
    help
    Supported Internal GPHY driver for VR9/AR10 platform

config GPHY_INT_SUPPORT 
    depends on ( (VR9 || AR10 ) && GPHY_DRIVER )
    default n
    bool "Support GPHY Interrupt for Link Status"
    help
    Supported Interrupt for Internal GPHY's for VR9/AR10 platform

config GPHY_NIB_ALIN_WORKAROUND 
    depends on ( (VR9 || AR10 ) && GPHY_DRIVER )
    default n
    bool "Support Nibble Align Error Workaround"
    help
    Supported GPHY Nibble Align Error Workaround
    
config GSWITCH_HD_IPG_WORKAROUND 
    depends on ( (VR9 || AR10 ) && GPHY_DRIVER )
    default n
    bool "Support GSWITCH Half Duplex IPG Workaround"
    help
    Supported GSWITCH Half Duplex IPG Workaround
endmenu
```

## target/linux/ltqcpe/files-2.6.32/drivers/pci/pcie/Kconfig.ifx
```kconfig
config IFX_PCIE
	bool "IFX PCIE Support"
	depends on PCIEPORTBUS && (VR9 || AR10 || HN1)

choice
	prompt "IFX PCIE: Default PCIe PHY Clock Mode"
	depends on IFX_PCIE
	default IFX_PCIE_PHY_36MHZ_MODE
	---help---
	  Select ifx pci express phy clock mode by default.
	config IFX_PCIE_PHY_36MHZ_MODE
	    bool "36MHz"
	    
	config IFX_PCIE_PHY_36MHZ_SSC_MODE
	    bool "36MHz SSC mode"

	config IFX_PCIE_PHY_25MHZ_MODE
	    bool "25MHz"

	config IFX_PCIE_PHY_100MHZ_MODE
	    bool "100MHz"
endchoice

config IFX_PCIE_1ST_CORE
	bool "IFX PCIE Core 0 Support"
	depends on IFX_PCIE
	default y

config IFX_PCIE_HW_SWAP
	bool "IFX PCIE Core 0 Outbound Hardware Swap Support"
	depends on IFX_PCIE_1ST_CORE
	default y
	---help---
	  This will enable PCIe Core 0 Outbound hardware swap. It should be enabled together with PCI

config IFX_PCIE_INBOUND_NO_HW_SWAP
	bool "IFX PCIE Core 0 Inbound Hardware Swap disabled"
	depends on IFX_PCIE_1ST_CORE
	default n
	---help---
	  This will disable PCIe Core 0 Inbound Hardware Swap. It should be only used together with VRX318

config IFX_PCIE_RST_EP_ACTIVE_HIGH
	bool "IFX PCIE Core 0 EP reset signal active high"
	depends on IFX_PCIE_1ST_CORE
	default n
	---help---
	  Normally PCIe EP reset is low active. It should be only used together with VRX318 due to dyning gasp

config IFX_PCIE_VR9_A11_HRST
	bool "IFX PCIE Core 0 VR9 A11 chip POR Hardware Reset Support"
	depends on IFX_PCIE_1ST_CORE && VR9
	default n
	---help---
	  This will enable PCIe Core 0 RC to use RCU_REQ_RST Hardware to reset EP. By default, 
	  GPIO 38 will be used for external PCIe EP reset

config IFX_PCIE_2ND_CORE
	bool "IFX PCIE Core 1 Support"
	depends on IFX_PCIE && AR10
	default n
	---help---
	  This will enable 2nd PCIe RC support

config IFX_PCIE1_HW_SWAP
	bool "IFX PCIE Core 1 Outbound Hardware Swap Support"
	depends on IFX_PCIE_2ND_CORE
	default n
	---help---
	  This will enable PCIe Core 1 Outbound data swap. It should be enabled together with PCI

config IFX_PCIE1_INBOUND_NO_HW_SWAP
	bool "IFX PCIE Core 1 Inbound Hardware Swap Disabled"
	depends on IFX_PCIE_2ND_CORE
	default n
	---help---
	  This will disable PCIe Core 1 Inbound Hardware Swap. It should be only used together with VRX318

config IFX_PCIE1_RST_EP_ACTIVE_HIGH
	bool "IFX PCIE Core 1 EP reset signal active high"
	depends on IFX_PCIE_2ND_CORE
	default n
	---help---
	  Normally PCIe EP reset is low active. It should be only used together with VRX318 due to dyning gasp

config IFX_PCIE_3RD_CORE
	bool "IFX PCIE Core 2 Support"
	depends on IFX_PCIE && AR10_GRX390
	default n
	---help---
	  This will enable 3rd PCIe RC support

config IFX_PCIE2_HW_SWAP
	bool "IFX PCIE Core 2 Outbound Hardware Swap Support"
	depends on IFX_PCIE_3RD_CORE
	default n
	---help---
	  This will enable PCIe Core 2 Outbound data swap. It should be enabled together with PCI

config IFX_PCIE2_INBOUND_NO_HW_SWAP
	bool "IFX PCIE Core 2 Inbound Hardware Swap Disabled"
	depends on IFX_PCIE_3RD_CORE
	default n
	---help---
	  This will disable PCIe Core 2 Inbound Hardware Swap. It should be only used together with VRX318

config IFX_PCIE2_RST_EP_ACTIVE_HIGH
	bool "IFX PCIE Core 2 EP reset signal active high"
	depends on IFX_PCIE_3RD_CORE
	default n
	---help---
	  Normally PCIe EP reset is low active. It should be only used together with VRX318 due to dyning gasp
```

## target/linux/ltqcpe/files-2.6.32vbg/arch/mips/Kconfig.ifx
```kconfig
config LTQ_VBG400
	bool "Lantiq WAVE400 board"
	select ARCH_MAY_HAVE_PC_FDC
	select BOOT_ELF32
	select BOOT_RAW
	select CEVT_R4K
	select CSRC_R4K
	select DMA_NONCOHERENT
	select GENERIC_ISA_DMA
	select IRQ_CPU
	select HW_HAS_PCI
	select MIPS_BOARDS_GEN
	select MIPS_CPU_SCACHE
	select MIPS_MSC
	select SWAP_IO_SPACE
	select SYS_HAS_CPU_MIPS32_R1
	select SYS_HAS_CPU_MIPS32_R2
	select CPU_MIPSR2_IRQ_VI
	select CPU_MIPSR2_IRQ_EI
	select SYS_HAS_CPU_NEVADA
	select SYS_HAS_CPU_RM7000
	select SYS_HAS_EARLY_PRINTK
	select SYS_SUPPORTS_32BIT_KERNEL
	select SYS_SUPPORTS_LITTLE_ENDIAN
	select SYS_SUPPORTS_MIPS_CMP
	select SYS_SUPPORTS_MULTITHREADING
	select SYS_SUPPORTS_SMARTMIPS
	help
	  This enables support for the Lantiq WAVE400 board 
	  board.

if LTQ_VBG400

menu "VBG400 Boards"
choice
	prompt "Board Type"

config VBG400_CHIPIT
	bool "VBG400 CHIPIT Board"

config VBG400_EVB
	bool "VBG400 Evaluation Board"

endchoice
endmenu

menu "Extra Configuration"
config VBG400_MAC_GMAC_INDEX
    int "GMAC Index 0/1 or 2 for both"
    default 2
    help
      index for gmac selected

config VBG400_PHY_INTERFACE_MODE
    int "Interface mode used, 0=mii 1=rgmii 2=rmii, etc."
    default 1
    help
      select the PHY interface mode

config VBG400_PHY_ADDR_GMAC_0
    int "select PHY address for GMAC0"
    default 0
    help
      select the PHY address for GMAC 0

config VBG400_PHY_ADDR_GMAC_1
    int "select PHY address for GMAC1"
    default 5
    help
      select the PHY address for GMAC 1
endmenu

endif  # LTQ_VBG400
```

## target/linux/ltqcpe/files-2.6.32vbg/drivers/net/Kconfig.ifx
```kconfig
config GMAC_SYNOP_NAPI
	tristate "Synopsys GMAC NAPI driver"
	default n
	---help---
	This is port of Synopsys GMAC NAPI driver from ARM OXNA platform.

config SYNOPGMACHOST_PCI
	tristate "Synopsys GMAC driver (old) for Lantiq WAVE400 board"
	default n
	---help---
	  This is Lantiq WAVE400 Synopsys network driver (reference).

config MII0_RGMII_MODE
    bool "1000MB"

config MII1_AUTONEG
    bool "Auto-negotiate"

config MII1_RGMII_MODE_100MB
    bool "100MB"
```

## target/linux/ltqcpe/files-2.6.32vbg/drivers/serial/Kconfig.ifx
```kconfig
config SERIAL_WAVE400_CONSOLE
	bool "Console on Lantiq wave400"
	select SERIAL_CORE
	default n
	select SERIAL_CORE_CONSOLE
	help
	  Support for Console on Lantiq wave400 board.
```

## tools/mtd-utils/Config.in
```kconfig
menu "Security"
	config UBIFS_FS_CRYPTO
		bool "Crypto UBIFS Root"
		default n
		select PACKAGE_kmod-ubifs_crypto
		help
			Enable thie if you want to use encrypted ubifs root
	
	config KERNEL_CRYPTO
		bool "Crypto Kernel"
		default n
		help
			Enable thie if you want to use encrypted linux kernel & second boot
endmenu
```
